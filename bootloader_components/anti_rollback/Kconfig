## bootloader_components/anti_rollback/Kconfig
```kconfig
menu "Pico FIDO2 security"

config PICO_FIDO2_SINGLE_SLOT_ANTI_ROLLBACK
    bool "Single-slot ESP32-S3 anti-rollback"
    default n
    depends on IDF_TARGET_ESP32S3
    help
        Keep the existing factory-only partition layout while rejecting signed
        application images whose security version is below the ESP32-S3 eFuse
        SECURE_VERSION floor. The floor is advanced only by host provisioning.

config PICO_FIDO2_SECURITY_VERSION
    int "Application security version"
    range 0 16
    default 0
    depends on IDF_TARGET_ESP32S3
    help
        Security epoch embedded in esp_app_desc. The A/B OTA path uses it to
        reject an older signed image than the currently running image without
        writing eFuse. The single-slot anti-rollback path may additionally
        compare the same epoch with the irreversible SECURE_VERSION eFuse.

endmenu
```

## src/fido2/Kconfig
```kconfig
menu "Pico FIDO2 transports"

config PICO_FIDO2_QEMU
    bool "ESP32-S3 QEMU platform mode"
    default n
    depends on IDF_TARGET_ESP32S3
    help
        Disable hardware USB driver/polling when running under Espressif QEMU.
        Protocol transports are exercised by native host emulation instead.

config PICO_FIDO2_BLE
    bool "FIDO2 over Bluetooth LE"
    default n
    depends on IDF_TARGET_ESP32S3
    help
        Expose the standard FIDO GATT service over ESP-NimBLE and route BLE
        MSG requests through the same CTAP2 core used by USB HID.

config PICO_FIDO2_BLE_PAIRING_WINDOW_SEC
    int "Fresh BLE pairing window in seconds"
    range 15 300
    default 60
    depends on PICO_FIDO2_BLE
    help
        A fresh BLE bond is accepted only during a one-time maintenance-granted
        pairing window. Existing bonded peers remain usable outside the window.

config PICO_FIDO2_WIFI_COMMISSIONING
    bool "Wi-Fi commissioning SoftAP"
    default n
    depends on IDF_TARGET_ESP32S3
    help
        Start a physically gated maintenance SoftAP. The Web UI reads device
        status and reuses the YubiKey management configuration/lock semantics
        for USB application enablement.

config PICO_FIDO2_DEVELOPMENT_MAINTENANCE_OPEN
    bool "Development maintenance profile"
    default n
    depends on PICO_FIDO2_WIFI_COMMISSIONING
    help
        Development-only profile. Allow an unauthenticated USB vendor command
        to open the maintenance SoftAP without a button gesture, use an open
        SoftAP, and treat the active maintenance session as already authorized
        for portal mutations. Secure Boot image validation, Flash Encryption,
        and A/B rollback are unchanged.

config PICO_FIDO2_WIFI_SSID_PREFIX
    string "Commissioning SoftAP SSID prefix"
    default "PicoFIDO2"
    depends on PICO_FIDO2_WIFI_COMMISSIONING

config PICO_FIDO2_WIFI_PASSWORD
    string "Commissioning SoftAP password"
    default "pico-fido2"
    depends on PICO_FIDO2_WIFI_COMMISSIONING

config PICO_FIDO2_WIFI_CHANNEL
    int "Commissioning SoftAP channel"
    range 1 13
    default 6
    depends on PICO_FIDO2_WIFI_COMMISSIONING

config PICO_FIDO2_WIFI_COMMISSION_PRESSES
    int "BOOT presses to enter commissioning"
    range 5 255
    default 5
    depends on PICO_FIDO2_WIFI_COMMISSIONING
    help
        Pico FIDO2 currently maps one through four BOOT presses to OTP slots.
        Commissioning therefore uses five or more presses to avoid changing
        existing OTP button behavior.

config PICO_FIDO2_WIFI_IDLE_TIMEOUT_SEC
    int "Commissioning idle timeout in seconds"
    range 30 3600
    default 300
    depends on PICO_FIDO2_WIFI_COMMISSIONING
    help
        Reboot after this much commissioning inactivity. Reboot exits Wi-Fi
        maintenance mode and restores the normal BLE FIDO transport.

config PICO_FIDO2_AB_OTA
    bool "Signed A/B firmware update"
    default n
    help
        Enable the transport-independent A/B update and boot-confirmation
        lifecycle. When Wi-Fi maintenance is also enabled it exposes the
        signed plaintext upload endpoint there. Secure Boot verifies the image
        and Flash Encryption encrypts writes with the device-local key. This
        feature uses ESP-IDF software rollback and does not advance the
        irreversible SECURE_VERSION eFuse.

config PICO_FIDO2_OTA_CONFIRM_DELAY_SEC
    int "A/B OTA boot confirmation delay in seconds"
    range 1 30
    default 5
    depends on PICO_FIDO2_AB_OTA
    help
        Keep a newly selected OTA image in PENDING_VERIFY until the normal
        core0 service loop has remained alive for this long. A crash, watchdog
        reset, or power loss before confirmation causes ESP-IDF to roll back.

endmenu
```
